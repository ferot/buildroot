## package/fann/Config.in
```kconfig
config BR2_PACKAGE_FANN
	bool "Fast Artificial Neural Network Library"
	help
	  This is a comment that explains what libfoo is. The help text
	  should be wrapped.
	
	  http://foosoftware.org/libfoo/
```

## package/my_app/Config.in
```kconfig
config BR2_PACKAGE_MY_APP
	bool "my_app"
	help
	  This is a comment that explains what libfoo is. The help text
	  should be wrapped.
	
	  http://foosoftware.org/libfoo/
```

## package/opencv3_contrib/Config.in
```kconfig
config BR2_PACKAGE_OPENCV3_CONTRIB
	bool "OpenCV3 Contrib - extra modules"
	help
	  This is a comment that explains what libfoo is. The help text
	  should be wrapped.
	
	  http://foosoftware.org/libfoo/
```

## package/sqlite_moderncpp/Config.in
```kconfig
config BR2_PACKAGE_SQLITE_MODERNCPP
	bool "C++14 wrapper for sqlite"
	help
	  This is a comment that explains what libfoo is. The help text
	  should be wrapped.
	
	  http://foosoftware.org/libfoo/
```
